## kernel/bsp/maix3/drivers/interdrv/pmu/Kconfig.pad64
```kconfig
config RT_PMU_SHUTDOWN_WAKEUP_SOURCE_PAD64
    string "PAD64 wakeup source name"
    default "PAD64_WAKEUP"

choice
    bool "PAD64 wakeup trigger type"
    default RT_PMU_SHUTDOWN_WAKEUP_PAD64_RISING_EDGE
    config RT_PMU_SHUTDOWN_WAKEUP_PAD64_HIGH_LEVEL
        bool "High level"
    config RT_PMU_SHUTDOWN_WAKEUP_PAD64_LOW_LEVEL
        bool "Low level"
    config RT_PMU_SHUTDOWN_WAKEUP_PAD64_RISING_EDGE
        bool "Rising edge"
    config RT_PMU_SHUTDOWN_WAKEUP_PAD64_FALLING_EDGE
        bool "Falling edge"
endchoice

config RT_PMU_SHUTDOWN_WAKEUP_PAD64_TRIGGER
    int
    default 0 if RT_PMU_SHUTDOWN_WAKEUP_PAD64_HIGH_LEVEL
    default 1 if RT_PMU_SHUTDOWN_WAKEUP_PAD64_LOW_LEVEL
    default 2 if RT_PMU_SHUTDOWN_WAKEUP_PAD64_RISING_EDGE
    default 3 if RT_PMU_SHUTDOWN_WAKEUP_PAD64_FALLING_EDGE

choice
    bool "PAD64 wakeup PAD pull bias"
    default RT_PMU_SHUTDOWN_WAKEUP_PAD64_BIAS_KEEP
    config RT_PMU_SHUTDOWN_WAKEUP_PAD64_BIAS_KEEP
        bool "Keep current PMU_IO_CFG pull setting"
    config RT_PMU_SHUTDOWN_WAKEUP_PAD64_BIAS_PULL_UP
        bool "Pull up"
    config RT_PMU_SHUTDOWN_WAKEUP_PAD64_BIAS_PULL_DOWN
        bool "Pull down"
    config RT_PMU_SHUTDOWN_WAKEUP_PAD64_BIAS_DISABLE
        bool "Disable pull up/down"
endchoice

config RT_PMU_SHUTDOWN_WAKEUP_PAD64_BIAS
    int
    default 0 if RT_PMU_SHUTDOWN_WAKEUP_PAD64_BIAS_KEEP
    default 1 if RT_PMU_SHUTDOWN_WAKEUP_PAD64_BIAS_PULL_UP
    default 2 if RT_PMU_SHUTDOWN_WAKEUP_PAD64_BIAS_PULL_DOWN
    default 3 if RT_PMU_SHUTDOWN_WAKEUP_PAD64_BIAS_DISABLE

config RT_PMU_SHUTDOWN_WAKEUP_PAD64_DEBOUNCE_TICKS
    int "PAD64 debounce ticks"
    default 256
    range 0 4095
```

## kernel/bsp/maix3/drivers/interdrv/pmu/Kconfig.pad66
```kconfig
config RT_PMU_SHUTDOWN_WAKEUP_SOURCE_PAD66
    string "PAD66 wakeup source name"
    default "PAD66_WAKEUP"

choice
    bool "PAD66 wakeup trigger type"
    default RT_PMU_SHUTDOWN_WAKEUP_PAD66_RISING_EDGE
    config RT_PMU_SHUTDOWN_WAKEUP_PAD66_HIGH_LEVEL
        bool "High level"
    config RT_PMU_SHUTDOWN_WAKEUP_PAD66_LOW_LEVEL
        bool "Low level"
    config RT_PMU_SHUTDOWN_WAKEUP_PAD66_RISING_EDGE
        bool "Rising edge"
    config RT_PMU_SHUTDOWN_WAKEUP_PAD66_FALLING_EDGE
        bool "Falling edge"
endchoice

config RT_PMU_SHUTDOWN_WAKEUP_PAD66_TRIGGER
    int
    default 0 if RT_PMU_SHUTDOWN_WAKEUP_PAD66_HIGH_LEVEL
    default 1 if RT_PMU_SHUTDOWN_WAKEUP_PAD66_LOW_LEVEL
    default 2 if RT_PMU_SHUTDOWN_WAKEUP_PAD66_RISING_EDGE
    default 3 if RT_PMU_SHUTDOWN_WAKEUP_PAD66_FALLING_EDGE

choice
    bool "PAD66 wakeup PAD pull bias"
    default RT_PMU_SHUTDOWN_WAKEUP_PAD66_BIAS_KEEP
    config RT_PMU_SHUTDOWN_WAKEUP_PAD66_BIAS_KEEP
        bool "Keep current PMU_IO_CFG pull setting"
    config RT_PMU_SHUTDOWN_WAKEUP_PAD66_BIAS_PULL_UP
        bool "Pull up"
    config RT_PMU_SHUTDOWN_WAKEUP_PAD66_BIAS_PULL_DOWN
        bool "Pull down"
    config RT_PMU_SHUTDOWN_WAKEUP_PAD66_BIAS_DISABLE
        bool "Disable pull up/down"
endchoice

config RT_PMU_SHUTDOWN_WAKEUP_PAD66_BIAS
    int
    default 0 if RT_PMU_SHUTDOWN_WAKEUP_PAD66_BIAS_KEEP
    default 1 if RT_PMU_SHUTDOWN_WAKEUP_PAD66_BIAS_PULL_UP
    default 2 if RT_PMU_SHUTDOWN_WAKEUP_PAD66_BIAS_PULL_DOWN
    default 3 if RT_PMU_SHUTDOWN_WAKEUP_PAD66_BIAS_DISABLE

config RT_PMU_SHUTDOWN_WAKEUP_PAD66_DEBOUNCE_TICKS
    int "PAD66 debounce ticks"
    default 256
    range 0 4095
```

## kernel/bsp/maix3/drivers/interdrv/pmu/Kconfig.pad67
```kconfig
config RT_PMU_SHUTDOWN_WAKEUP_SOURCE_PAD67
    string "PAD67 wakeup source name"
    default "PAD67_WAKEUP"

choice
    bool "PAD67 wakeup trigger type"
    default RT_PMU_SHUTDOWN_WAKEUP_PAD67_RISING_EDGE
    config RT_PMU_SHUTDOWN_WAKEUP_PAD67_HIGH_LEVEL
        bool "High level"
    config RT_PMU_SHUTDOWN_WAKEUP_PAD67_LOW_LEVEL
        bool "Low level"
    config RT_PMU_SHUTDOWN_WAKEUP_PAD67_RISING_EDGE
        bool "Rising edge"
    config RT_PMU_SHUTDOWN_WAKEUP_PAD67_FALLING_EDGE
        bool "Falling edge"
endchoice

config RT_PMU_SHUTDOWN_WAKEUP_PAD67_TRIGGER
    int
    default 0 if RT_PMU_SHUTDOWN_WAKEUP_PAD67_HIGH_LEVEL
    default 1 if RT_PMU_SHUTDOWN_WAKEUP_PAD67_LOW_LEVEL
    default 2 if RT_PMU_SHUTDOWN_WAKEUP_PAD67_RISING_EDGE
    default 3 if RT_PMU_SHUTDOWN_WAKEUP_PAD67_FALLING_EDGE

choice
    bool "PAD67 wakeup PAD pull bias"
    default RT_PMU_SHUTDOWN_WAKEUP_PAD67_BIAS_KEEP
    config RT_PMU_SHUTDOWN_WAKEUP_PAD67_BIAS_KEEP
        bool "Keep current PMU_IO_CFG pull setting"
    config RT_PMU_SHUTDOWN_WAKEUP_PAD67_BIAS_PULL_UP
        bool "Pull up"
    config RT_PMU_SHUTDOWN_WAKEUP_PAD67_BIAS_PULL_DOWN
        bool "Pull down"
    config RT_PMU_SHUTDOWN_WAKEUP_PAD67_BIAS_DISABLE
        bool "Disable pull up/down"
endchoice

config RT_PMU_SHUTDOWN_WAKEUP_PAD67_BIAS
    int
    default 0 if RT_PMU_SHUTDOWN_WAKEUP_PAD67_BIAS_KEEP
    default 1 if RT_PMU_SHUTDOWN_WAKEUP_PAD67_BIAS_PULL_UP
    default 2 if RT_PMU_SHUTDOWN_WAKEUP_PAD67_BIAS_PULL_DOWN
    default 3 if RT_PMU_SHUTDOWN_WAKEUP_PAD67_BIAS_DISABLE

config RT_PMU_SHUTDOWN_WAKEUP_PAD67_DEBOUNCE_TICKS
    int "PAD67 debounce ticks"
    default 256
    range 0 4095
```

## kernel/bsp/maix3/drivers/interdrv/pmu/Kconfig.pad68
```kconfig
config RT_PMU_SHUTDOWN_WAKEUP_SOURCE_PAD68
    string "PAD68 wakeup source name"
    default "PAD68_WAKEUP"

choice
    bool "PAD68 wakeup trigger type"
    default RT_PMU_SHUTDOWN_WAKEUP_PAD68_RISING_EDGE
    config RT_PMU_SHUTDOWN_WAKEUP_PAD68_HIGH_LEVEL
        bool "High level"
    config RT_PMU_SHUTDOWN_WAKEUP_PAD68_LOW_LEVEL
        bool "Low level"
    config RT_PMU_SHUTDOWN_WAKEUP_PAD68_RISING_EDGE
        bool "Rising edge"
    config RT_PMU_SHUTDOWN_WAKEUP_PAD68_FALLING_EDGE
        bool "Falling edge"
endchoice

config RT_PMU_SHUTDOWN_WAKEUP_PAD68_TRIGGER
    int
    default 0 if RT_PMU_SHUTDOWN_WAKEUP_PAD68_HIGH_LEVEL
    default 1 if RT_PMU_SHUTDOWN_WAKEUP_PAD68_LOW_LEVEL
    default 2 if RT_PMU_SHUTDOWN_WAKEUP_PAD68_RISING_EDGE
    default 3 if RT_PMU_SHUTDOWN_WAKEUP_PAD68_FALLING_EDGE

choice
    bool "PAD68 wakeup PAD pull bias"
    default RT_PMU_SHUTDOWN_WAKEUP_PAD68_BIAS_KEEP
    config RT_PMU_SHUTDOWN_WAKEUP_PAD68_BIAS_KEEP
        bool "Keep current PMU_IO_CFG pull setting"
    config RT_PMU_SHUTDOWN_WAKEUP_PAD68_BIAS_PULL_UP
        bool "Pull up"
    config RT_PMU_SHUTDOWN_WAKEUP_PAD68_BIAS_PULL_DOWN
        bool "Pull down"
    config RT_PMU_SHUTDOWN_WAKEUP_PAD68_BIAS_DISABLE
        bool "Disable pull up/down"
endchoice

config RT_PMU_SHUTDOWN_WAKEUP_PAD68_BIAS
    int
    default 0 if RT_PMU_SHUTDOWN_WAKEUP_PAD68_BIAS_KEEP
    default 1 if RT_PMU_SHUTDOWN_WAKEUP_PAD68_BIAS_PULL_UP
    default 2 if RT_PMU_SHUTDOWN_WAKEUP_PAD68_BIAS_PULL_DOWN
    default 3 if RT_PMU_SHUTDOWN_WAKEUP_PAD68_BIAS_DISABLE
```

## kernel/bsp/maix3/drivers/interdrv/pmu/Kconfig.pad69
```kconfig
config RT_PMU_SHUTDOWN_WAKEUP_SOURCE_PAD69
    string "PAD69 wakeup source name"
    default "PAD69_WAKEUP"

choice
    bool "PAD69 wakeup trigger type"
    default RT_PMU_SHUTDOWN_WAKEUP_PAD69_RISING_EDGE
    config RT_PMU_SHUTDOWN_WAKEUP_PAD69_HIGH_LEVEL
        bool "High level"
    config RT_PMU_SHUTDOWN_WAKEUP_PAD69_LOW_LEVEL
        bool "Low level"
    config RT_PMU_SHUTDOWN_WAKEUP_PAD69_RISING_EDGE
        bool "Rising edge"
    config RT_PMU_SHUTDOWN_WAKEUP_PAD69_FALLING_EDGE
        bool "Falling edge"
endchoice

config RT_PMU_SHUTDOWN_WAKEUP_PAD69_TRIGGER
    int
    default 0 if RT_PMU_SHUTDOWN_WAKEUP_PAD69_HIGH_LEVEL
    default 1 if RT_PMU_SHUTDOWN_WAKEUP_PAD69_LOW_LEVEL
    default 2 if RT_PMU_SHUTDOWN_WAKEUP_PAD69_RISING_EDGE
    default 3 if RT_PMU_SHUTDOWN_WAKEUP_PAD69_FALLING_EDGE

choice
    bool "PAD69 wakeup PAD pull bias"
    default RT_PMU_SHUTDOWN_WAKEUP_PAD69_BIAS_KEEP
    config RT_PMU_SHUTDOWN_WAKEUP_PAD69_BIAS_KEEP
        bool "Keep current PMU_IO_CFG pull setting"
    config RT_PMU_SHUTDOWN_WAKEUP_PAD69_BIAS_PULL_UP
        bool "Pull up"
    config RT_PMU_SHUTDOWN_WAKEUP_PAD69_BIAS_PULL_DOWN
        bool "Pull down"
    config RT_PMU_SHUTDOWN_WAKEUP_PAD69_BIAS_DISABLE
        bool "Disable pull up/down"
endchoice

config RT_PMU_SHUTDOWN_WAKEUP_PAD69_BIAS
    int
    default 0 if RT_PMU_SHUTDOWN_WAKEUP_PAD69_BIAS_KEEP
    default 1 if RT_PMU_SHUTDOWN_WAKEUP_PAD69_BIAS_PULL_UP
    default 2 if RT_PMU_SHUTDOWN_WAKEUP_PAD69_BIAS_PULL_DOWN
    default 3 if RT_PMU_SHUTDOWN_WAKEUP_PAD69_BIAS_DISABLE
```
