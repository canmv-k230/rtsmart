## kernel/bsp/maix3/drivers/extdrv/brcmfmac/Kconfig
```kconfig
menuconfig RT_USING_BRCMFMAC
    bool "Broadcom FullMAC (brcmfmac) SDIO Wi-Fi"
    depends on RT_USING_WIFI && RT_USING_SDIO
    depends on RT_USING_DFS
    select RT_WLAN_OFFLOAD
    select RT_WLAN_OFFLOAD_CONTROL
    select RT_USING_TIMER_SOFT
    default n
    help
        Enable the native RT-Smart port of Linux brcmfmac for Broadcom and
        Cypress FullMAC SDIO devices. The first supported target is the
        BCM43430A1 device (02d0:a9a6), with a chip/firmware mapping
        table for additional Broadcom and Cypress FullMAC SDIO devices.
        Firmware owns authentication, association, WPA/WPA2 key exchange, and
        AP operation; RT-Thread WLAN management and lwIP are connected through
        the WLAN offload framework.

if RT_USING_BRCMFMAC

config BRCMFMAC_FIRMWARE_PATH
    string "Installed firmware directory"
    default "/bin/firmware/brcmfmac"

config BRCMFMAC_COUNTRY_CODE
    string "Regulatory country code"
    default "CN"

config BRCMFMAC_COUNTRY_REVISION
    int "Regulatory country revision"
    range 0 999
    default 0
    help
        Use revision 0 for BCM43430, matching both Linux brcmfmac ISO 3166
        fallback and the K230 SDK bcmdhd configuration.

config BRCMFMAC_BCM43430A1_NVRAM
    string "BCM43430A1 board NVRAM file"
    default "nvram.txt"
    help
        Select the NVRAM matching the installed BCM43430A1 module.
        The K230 CanMV default uses the nvram.txt calibration shipped with
        its Linux SDK. nvram_ap6212.txt remains available for boards whose
        module and RF layout match that AP6212A V1.0.2 calibration.

config BRCMFMAC_INIT_THREAD_STACK_SIZE
    int "Initialization worker stack size"
    range 8192 32768
    default 12288

config BRCMFMAC_INIT_THREAD_PRIORITY
    int "Initialization worker priority"
    range 5 30
    default 14
    help
        Keep this at lower urgency (numerically greater) than the RX and TX
        worker priorities.
        Firmware responses must run ahead of the initialization worker that
        waits for them.

config BRCMFMAC_RX_THREAD_PRIORITY
    int "Receive thread priority"
    range 1 31
    default 11
    help
        Keep this numerically greater than the lwIP TCP/IP thread priority so
        packet delivery cannot fill the TCP/IP mailbox before lwIP runs.

config BRCMFMAC_RX_THREAD_STACK_SIZE
    int "Receive thread stack size"
    range 4096 32768
    default 8192

config BRCMFMAC_TX_THREAD_PRIORITY
    int "Transmit thread priority"
    range 1 31
    default 12

config BRCMFMAC_TX_THREAD_STACK_SIZE
    int "Transmit thread stack size"
    range 2048 16384
    default 4096

config BRCMFMAC_TX_QUEUE_DEPTH
    int "Transmit queue depth"
    range 16 2048
    default 256
    help
        Linux brcmfmac uses a 2048-packet queue. The smaller RT-Smart default
        still leaves enough buffering to keep a full SDPCM credit window busy
        without consuming several megabytes of kernel heap.

config BRCMFMAC_TX_QUEUE_WAIT_MS
    int "Transmit queue backpressure timeout (ms)"
    range 0 5000
    default 1000
    help
        Time to wait for the TX worker when the bounded queue is full. The
        wait provides the queue stop/wake backpressure used by Linux brcmfmac,
        pacing the direct lwIP transmit path to the firmware credit rate. If
        the timeout expires, the frame is consumed as a normal link-layer drop
        because returning a temporary error causes a tight sender retry loop.

config BRCMFMAC_TX_GLOM_FRAMES
    int "Maximum frames per SDIO transmit aggregate"
    range 1 32
    default 32
    help
        Queue and combine Ethernet frames into the host-to-firmware SDPCM
        format used by Linux brcmfmac. This reduces CMD53 setup overhead.

config BRCMFMAC_TX_GLOM_WAIT_MS
    int "Transmit aggregation wait (ms)"
    range 0 10
    default 1

config BRCMFMAC_TX_RETRIES
    int "SDIO control transmit retries after bus errors"
    range 0 5
    default 2
    help
        Abort and terminate a failed function-2 control frame, then retry it
        with the same SDPCM sequence number. Linux does not retry failed data
        aggregates because firmware may already have consumed complete
        subframes before the SDIO error.

config BRCMFMAC_SDIO_WATCHDOG_MS
    int "SDIO watchdog interval (ms)"
    range 1 20
    default 10
    help
        Run software timeout handling at this interval. Like Linux brcmfmac,
        idle watchdog ticks do not poll SDIO interrupt status; a TX credit wait
        explicitly requests a status scan when firmware progress is needed.

config BRCMFMAC_TX_CREDIT_TIMEOUT_MS
    int "Transmit credit stall warning interval (ms)"
    range 500 30000
    default 2000
    help
        Report prolonged SDPCM data-credit stalls at this interval. Data stays
        queued, as in Linux brcmfmac; only command timeouts and actual SDIO
        failures are treated as transport faults.

config BRCMFMAC_TX_CREDIT_POLL_MS
    int "Transmit credit wait interval (ms)"
    range 1 20
    default 2
    help
        Recheck the SDPCM credit window at this interval while waiting for a
        firmware update. The receive watchdog scans device interrupt status
        when a card interrupt is lost or delayed.

config BRCMFMAC_CONTROL_TIMEOUT_MS
    int "Firmware command timeout (ms)"
    range 1000 30000
    default 5000

config BRCMFMAC_CONNECT_TIMEOUT_MS
    int "Firmware connection event timeout (ms)"
    range 1000 9000
    default 9000
    help
        Fail an in-progress connection when firmware does not report a result.
        This must remain below RT-Thread WLAN management's 10 second wait so
        the failure event clears both driver and offload request state.

config BRCMFMAC_VERIFY_FIRMWARE
    bool "Verify firmware download"
    default n

endif
```

## kernel/bsp/maix3/drivers/extdrv/cyw43xx/Kconfig
```kconfig
menuconfig RT_USING_CYW43XX
    bool "CYW43xx SDIO Wi-Fi (Recommend use brcmfmac)"
    depends on RT_USING_WIFI && RT_USING_SDIO && !RT_USING_BRCMFMAC
    default n
    help
        Enable the legacy CYW43xx SDIO Wi-Fi driver. It is mutually
        exclusive with the native brcmfmac port because both drivers claim
        the same Broadcom SDIO device IDs.

    if RT_USING_CYW43XX
        menu "Thread Settings"

            config CYW43XX_THREAD_PRIORITY
                int "Thread priority"
                default 10

            config CYW43XX_THREAD_STACK_SIZE
                int "Thread stack size"
                default 4096

        endmenu
    endif
```

## kernel/bsp/maix3/drivers/extdrv/esp_hosted/Kconfig
```kconfig
menuconfig RT_USING_ESP_HOSTED_WIFI
    bool "ESP-Hosted Wi-Fi offload driver (FG/NG)"
    depends on RT_USING_WIFI
    depends on (RT_USING_SPI && RT_USING_QSPI) || RT_USING_SDIO
    select RT_WLAN_OFFLOAD
    default n
    help
        Use an ESP running ESP-Hosted-FG or ESP-Hosted-NG as a Wi-Fi
        coprocessor through the RT-Thread WLAN offload framework. The SDIO
        transport may be enabled with other vendor drivers because binding
        is selected by the card manufacturer and product IDs.

if RT_USING_ESP_HOSTED_WIFI

    menu "Protocol and WLAN Settings"

    choice ESP_HOSTED_WIFI_PROTOCOL
        prompt "ESP-Hosted firmware protocol"
        default ESP_HOSTED_WIFI_FG

        config ESP_HOSTED_WIFI_FG
            bool "ESP-Hosted-FG (firmware connection offload)"
            select RT_USING_TIMER_SOFT

        config ESP_HOSTED_WIFI_NG
            bool "ESP-Hosted-NG (host supplicant)"
            depends on RT_USING_LWP && RT_USING_DFS && RT_USING_DFS_DEVFS
            select ESP_HOSTED_WIFI_CONTROL
            select RT_WLAN_OFFLOAD_SUPPLICANT
            select RT_WLAN_OFFLOAD_EMBEDDED_HOSTAPD
            help
                NG exposes host-managed authentication, association, key,
                EAPOL, management-frame, and AP-station operations. The
                embedded WLAN supplicant and SoftAP authenticator support
                RT-Thread WLAN management, while /dev/wlanctlN remains
                available for a full userspace supplicant.
    endchoice

    config ESP_HOSTED_WIFI_CONTROL
        bool "Expose WLAN offload userspace control device"
        depends on RT_USING_LWP && RT_USING_DFS && RT_USING_DFS_DEVFS
        select RT_WLAN_OFFLOAD_CONTROL
        default y
        help
            Exposes a /dev/wlanctlN control node for libwlan_offload
            diagnostics and userspace integrations. FG retains firmware WPA
            offload and does not advertise the external-supplicant capability.

    config ESP_HOSTED_WIFI_AUTO_START
        bool "Initialize the station interface during driver probe"
        depends on RT_WLAN_MANAGE_ENABLE
        default y
        help
            Start the ESP link, enable station mode, and attach the default
            RT-Thread network protocol when the transport driver registers.
            The probe runs in a dedicated worker, so a missing or unresponsive
            ESP does not delay the rest of RT-Smart initialization. Disable
            this only when an application must control link startup explicitly
            through the WLAN offload control device.

    endmenu

    menu "Common Transport Settings"

    choice ESP_HOSTED_WIFI_TRANSPORT
        prompt "Bus transport"
        default ESP_HOSTED_WIFI_TRANSPORT_SPI if RT_USING_SPI && RT_USING_QSPI
        default ESP_HOSTED_WIFI_TRANSPORT_SDIO

        config ESP_HOSTED_WIFI_TRANSPORT_SPI
            bool "SPI full-duplex"
            depends on RT_USING_SPI && RT_USING_QSPI

        config ESP_HOSTED_WIFI_TRANSPORT_SDIO
            bool "SDIO"
            depends on RT_USING_SDIO
    endchoice

    config ESP_HOSTED_WIFI_CHECKSUM
        bool "Use transport checksums when advertised by firmware"
        default y

    config ESP_HOSTED_WIFI_5GHZ
        bool "Advertise 5 GHz channels"
        default n
        help
            Enable only for an ESP target and firmware build with 5 GHz Wi-Fi.

    config ESP_HOSTED_WIFI_BOOT_TIMEOUT_MS
        int "Firmware boot timeout (ms)"
        range 1000 60000
        default 15000
        help
            Maximum time for an ESP link probe to wait for the firmware boot
            event. Automatic probes wait in their worker and never block the
            RT-Smart initialization thread.

    config ESP_HOSTED_WIFI_COMMAND_TIMEOUT_MS
        int "Control command timeout (ms)"
        range 1000 60000
        default 10000

    config ESP_HOSTED_WIFI_CONTROL_BUFFER_SIZE
        int "Maximum fragmented FG control message (bytes)"
        range 2048 65535
        default 16384
        depends on ESP_HOSTED_WIFI_FG

    config ESP_HOSTED_WIFI_THREAD_STACK_SIZE
        int "Transport worker stack size"
        range 4096 32768
        default 8192

    config ESP_HOSTED_WIFI_THREAD_PRIORITY
        int "Transport worker priority"
        range 5 30
        default 15

    config ESP_HOSTED_WIFI_TX_QUEUE_DEPTH
        int "Transport TX queue depth"
        range 4 64
        default 16

    endmenu

if ESP_HOSTED_WIFI_TRANSPORT_SPI

    menu "SPI Transport Settings"

    choice ESP_HOSTED_WIFI_SPI_BUS
        prompt "SPI bus"
        default ESP_HOSTED_WIFI_SPI_BUS_SPI0

        config ESP_HOSTED_WIFI_SPI_BUS_SPI0
            bool "spi0 (OSPI controller)"

        config ESP_HOSTED_WIFI_SPI_BUS_SPI1
            bool "spi1 (QSPI0)"

        config ESP_HOSTED_WIFI_SPI_BUS_SPI2
            bool "spi2 (QSPI1)"
    endchoice

    config ESP_HOSTED_WIFI_SPI_DEVICE_NAME
        string "SPI device name"
        default "esp-hosted-wifi"

    config ESP_HOSTED_WIFI_SPI_MAX_HZ
        int "SPI clock frequency (Hz)"
        range 1000000 40000000
        default 5000000

    choice ESP_HOSTED_WIFI_SPI_MODE_CHOICE
        prompt "SPI mode"
        default ESP_HOSTED_WIFI_SPI_MODE_3

        config ESP_HOSTED_WIFI_SPI_MODE_1
            bool "Mode 1 (CPOL=0, CPHA=1)"

        config ESP_HOSTED_WIFI_SPI_MODE_2
            bool "Mode 2 (CPOL=1, CPHA=0)"

        config ESP_HOSTED_WIFI_SPI_MODE_3
            bool "Mode 3 (CPOL=1, CPHA=1)"
    endchoice

    config ESP_HOSTED_WIFI_SPI_MODE
        int
        default 1 if ESP_HOSTED_WIFI_SPI_MODE_1
        default 2 if ESP_HOSTED_WIFI_SPI_MODE_2
        default 3

    config ESP_HOSTED_WIFI_SPI_CS_PIN
        int "Chip-select GPIO"
        range -1 63
        default 14

    config ESP_HOSTED_WIFI_SPI_CLK_PIN
        int "SPI clock GPIO"
        range 0 63
        default 15

    config ESP_HOSTED_WIFI_SPI_D0_PIN
        int "SPI MOSI GPIO"
        range 0 63
        default 16

    config ESP_HOSTED_WIFI_SPI_D1_PIN
        int "SPI MISO GPIO"
        range 0 63
        default 17

    config ESP_HOSTED_WIFI_HANDSHAKE_PIN
        int "Handshake GPIO"
        range 0 63
        default 20

    config ESP_HOSTED_WIFI_HANDSHAKE_ACTIVE_LOW
        bool "Handshake is active low"
        default n

    config ESP_HOSTED_WIFI_DATA_READY_PIN
        int "Data-ready GPIO"
        range 0 63
        default 21

    config ESP_HOSTED_WIFI_DATA_READY_ACTIVE_LOW
        bool "Data-ready is active low"
        default n

    config ESP_HOSTED_WIFI_RESET_PIN
        int "ESP EN/reset GPIO (-1 disables host reset)"
        range -1 63
        default -1

    config ESP_HOSTED_WIFI_RESET_ACTIVE_LOW
        bool "Reset is asserted low"
        default y

    config ESP_HOSTED_WIFI_RESET_PULSE_MS
        int "Reset pulse duration (ms)"
        range 1 1000
        default 10

    endmenu

endif

if ESP_HOSTED_WIFI_TRANSPORT_SDIO

    menu "SDIO Transport Settings"

    config ESP_HOSTED_WIFI_SDIO_MANUFACTURER
        hex "SDIO manufacturer ID"
        range 0x0000 0xffff
        default 0x6666

    config ESP_HOSTED_WIFI_SDIO_PRODUCT
        hex "SDIO product ID"
        range 0x0000 0xffff
        default 0x2222
        help
            Common IDs are 6666:2222, 6666:3333, 0092:6666, and
            0092:7777. The RT-Thread SDIO matcher accepts one ID per driver.

    config ESP_HOSTED_WIFI_SDIO_RX_BUFFER_SIZE
        int "Maximum SDIO aggregate RX size"
        range 2048 65536
        default 16384

    config ESP_HOSTED_WIFI_SDIO_TOKEN_SIZE
        int "Fallback firmware TX credit size"
        range 512 16384
        default 15872
        help
            Used only when old firmware omits its RX-buffer-size boot TLV.

    endmenu

endif

    menu "Logging"

    choice ESP_HOSTED_WIFI_LOG_LEVEL
        prompt "Module log level"
        default ESP_HOSTED_WIFI_LOG_LEVEL_INFO
        help
            Select the minimum log level compiled into the ESP-Hosted Wi-Fi
            driver. Debug includes transport frame and protocol trace output.

        config ESP_HOSTED_WIFI_LOG_LEVEL_ERROR
            bool "Errors only"

        config ESP_HOSTED_WIFI_LOG_LEVEL_WARNING
            bool "Warnings and errors"

        config ESP_HOSTED_WIFI_LOG_LEVEL_INFO
            bool "Information (default)"

        config ESP_HOSTED_WIFI_LOG_LEVEL_DEBUG
            bool "Debug and above"
    endchoice

    endmenu

endif
```
