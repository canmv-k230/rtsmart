## kernel/bsp/maix3/drivers/extdrv/realtek/Kconfig
```kconfig
menuconfig RT_USING_REALTEK
    bool "Realtek SDIO Wi-Fi"
    depends on RT_USING_WIFI && RT_USING_SDIO
    default n
    help
        Enable a Realtek SDIO Wi-Fi driver. It may be built together with
        other SDIO Wi-Fi drivers; the SDIO manufacturer and product IDs
        select the driver at runtime.

    if RT_USING_REALTEK
        choice
            prompt "Realtek module"
            default REALTEK_SDIO_RTL8189FTV

            config REALTEK_SDIO_RTL8189FTV
                bool "rtl8189"

            config REALTEK_SDIO_RTL8733BS
                bool "rtl8733BS"

        endchoice

        config REALTEK_INTERACTIVE_CMD
            bool "RealTek Interactive CMDs"
            default n
            select REALTEK_ENABLE_DEBUG

        config REALTEK_ENABLE_DEBUG
            bool "RealTek Enable Debug"
            default n

        config REALTEK_ENABLE_ADAPTIVITY
            bool "RealTek Enable Adaptivity"
            default n
    endif
```

## kernel/bsp/maix3/drivers/extdrv/regulator/Kconfig
```kconfig
menuconfig RT_USING_REGULATOR
    bool "Enable regulator Driver"
    default n
    help
        Board rails come from board/configs/<board>/regulator_config.c.

    if RT_USING_REGULATOR
        config RT_REGULATOR_ENABLE_BUILTIN_CMD
            bool "Enable the regulator shell command"
            depends on RT_USING_MSH
            default n
            help
                Enable the regulator MSH command. It lists the board
                rails and can enable them and set or sweep their voltage
                within the rail limits.

        config RT_USING_REGULATOR_TPS6286X
            bool "Use TPS6286X"
            default n

        config RT_USING_REGULATOR_GPIO
            bool "Use GPIO-controlled regulators"
            depends on RT_USING_GPIO
            default n
            help
                Switches and LDOs with an enable GPIO and/or a GPIO selecting
                between two voltages, such as SD card power.

        config RT_USING_REGULATOR_K230_IOBANK
            bool "Use K230 IO bank voltage switching"
            depends on RT_USING_FPIOA
            default n
            help
                Switches the voltage mode of a whole K230 IO bank between
                3.3 V and 1.8 V, together with the regulator for the bank's
                external rail (e.g. a GPIO regulator switching pull-ups), in
                the order that keeps 1.8 V pads off 3.3 V. For SD UHS-I.
    endif
```

## kernel/bsp/maix3/drivers/extdrv/spinor/Kconfig
```kconfig
config RT_USING_SPINOR
    bool "Native SPI NOR driver"
    depends on RT_USING_SPI
    select RT_USING_QSPI
    default n
    help
        Native SPI NOR access through the RT-Thread QSPI bus, with optional
        MTD NOR partitions. Supported chips are listed in spinor_chips.c.
```
