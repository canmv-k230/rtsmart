## kernel/bsp/maix3/drivers/interdrv/Kconfig
```kconfig
menu "InterDriver"
    menuconfig RT_USING_K230_ADC
        bool "Enable Kendryte K230 ADC hardware driver"
        select RT_USING_ADC
        default y

        if RT_USING_K230_ADC
            config RT_ADC_ENABLE_ACODEC_HP_DETECT
                bool "Enable acodec headphone detect"
                default n

            config RT_ADC_ACODEC_HP_DETECT_CHANNEL
                int "Acodec headphone detect ADC channel"
                range 0 5
                default 5
                depends on RT_ADC_ENABLE_ACODEC_HP_DETECT
        endif

    menuconfig RT_USING_CIPHER
        bool "Enable CIPHER"
        default n

        if RT_USING_CIPHER
            config RT_USING_AES
                bool "Use HW AES accelerator"
                default n
            config RT_USING_HASH
                bool "Use HW SHA256 accelerator"
                default n
            menuconfig RT_USING_PUFS
                bool "Use HW PUFS accelerator"
                default n
                select RT_USING_FPIOA

                if RT_USING_PUFS
                    config RT_USING_PUFS_FILE_HASH
                        bool "Enable calculate file hash with pufs"
                        default n
                        depends on RT_USING_MSH
                        help
                            Enable the PUFS file-hash MSH commands for calculating a
                            file digest with the PUFS hash engine.

                            Command provided:
                            - sha256 <path>
                            - pufs_file_hash <path> [sha224|sha256|sha384|sha512|sha512_224|sha512_256|sm3]

                    config RT_PUFS_ENABLE_BUILTIN_CMD
                        bool "Enable pufs msh commands"
                        default n
                        depends on RT_USING_MSH
                        help
                            Enable built-in MSH commands for the PUFS driver.

                            Commands provided:
                            - pufs_otp read <addr> <len>
                            - pufs_otp_sec query
                            - pufs_otp_sec write <jtag|secure_boot|isp|all> [...]
                            - pufs_otp_sec lock

                    config RT_PUFS_OTP_WRITE_ENABLE
                        bool "Enable OTP write and lock operations (DANGER: irreversible)"
                        default n
                        help
                            When enabled, OTP write, lock, key-program and zeroize
                            operations will actually program the one-time-programmable
                            fuses.  This is IRREVERSIBLE.

                            When disabled (default), these operations only print what
                            would be done and return success without touching hardware.
                            Use this dry-run mode to verify your OTP programming flow
                            before committing.

                            User-accessible OTP range: 0x100-0x3FF (OTPKEY_8..31).
                            Addresses below 0x100 are reserved for system keys.
                endif
        endif

    menuconfig RT_USING_FPIOA
        bool "Enable FPIOA Driver"
        default y

        if RT_USING_FPIOA
            config RT_FPIOA_ENABLE_BUILTIN_CMD
                bool "Enable fpioa test command"
                depends on RT_USING_MSH
                default n
        endif

    config RT_USING_VG_LITE
        bool "Enable VG-Lite GPU driver"
        default y
        depends on RT_USING_USERSPACE

    config RT_USING_GNNE
        bool "Enable GNNE driver for ai"
        default y

    config RT_USING_FFT
        bool "Enable FFT driver"
        default n
        depends on RT_USING_MPP

    menuconfig RT_USING_GPIO
        bool "Enable GPIO Driver"
        default n
        select RT_USING_FPIOA

        if RT_USING_GPIO
            config RT_GPIO_ENABLE_BUILTIN_CMD
                bool "Enable gpio test command"
                depends on RT_USING_MSH
                default n
                help
                    Enable the built-in GPIO MSH test command.

                    Commands provided:
                    - gpio mode <pin> <mode>
                    - gpio write <pin> <value>
                    - gpio read <pin>
                    - gpio pulse <pin> <high_ms> <low_ms> [count]
                    - gpio irq <pin> <mode>
                    - gpio irq_enable <pin>
                    - gpio irq_disable <pin>
        endif

    menuconfig RT_USING_HARDLOCK
        bool "Enable HardLock Driver"
        default n

        if RT_USING_HARDLOCK
            config RT_HARD_LOCK_USE_DUMMY
                bool "Use Dummy HardLock Impl"
                default y
        endif

    menuconfig RT_USING_HWTIMER
        bool "Using hardware timer device drivers"
        default n

        if RT_USING_HWTIMER
            choice
                bool "Timer IRQ Method"

                config RT_TIMER_IRQ_METHOD_WORKQUEUE
                    bool "WorkQueue"
                config RT_TIMER_IRQ_METHOD_DIRECT
                    bool "Direct"
            endchoice

            config RT_USING_HW_TIMER0
                bool "Enable HW Timer0"
                default n
            config RT_USING_HW_TIMER1
                bool "Enable HW Timer1"
                default n
            config RT_USING_HW_TIMER2
                bool "Enable HW Timer2"
                default n
            config RT_USING_HW_TIMER3
                bool "Enable HW Timer3"
                default n
            config RT_USING_HW_TIMER4
                bool "Enable HW Timer4"
                default n
            config RT_USING_HW_TIMER5
                bool "Enable HW Timer5"
                default n
        endif

    menuconfig RT_USING_I2C
        bool "Enable I2C"
        default n

        if RT_USING_I2C
            config RT_I2C_ENABLE_BUILTIN_CMD
                bool "Enable I2C diagnostic commands"
                depends on RT_USING_MSH
                select RT_USING_FPIOA
                default n
                help
                    Enable the i2c_transfer and i2cdetect MSH commands.

            config RT_USING_SOFT_I2C
                bool "Enable Soft I2C"
                default n
                select RT_USING_FPIOA

            config RT_USING_I2C0
                bool "Enable I2C0"
                default n
            if RT_USING_I2C0
                choice I2C0_MODE_CHOICE
                    bool "I2C0 mode"
                    default I2C0_MODE_MASTER
                    config I2C0_MODE_MASTER
                        bool "Master"
                    config I2C0_MODE_SLAVE
                        bool "Slave"
                endchoice
                config I2C0_MODE
                    int
                    default 0 if I2C0_MODE_MASTER
                    default 1 if I2C0_MODE_SLAVE
            endif

            config RT_USING_I2C1
                bool "Enable I2C1"
                default n
            if RT_USING_I2C1
                choice I2C1_MODE_CHOICE
                    bool "I2C1 mode"
                    default I2C1_MODE_MASTER
                    config I2C1_MODE_MASTER
                        bool "Master"
                    config I2C1_MODE_SLAVE
                        bool "Slave"
                endchoice
                config I2C1_MODE
                    int
                    default 0 if I2C1_MODE_MASTER
                    default 1 if I2C1_MODE_SLAVE
            endif

            config RT_USING_I2C2
                bool "Enable I2C2"
                default n
            if RT_USING_I2C2
                choice I2C2_MODE_CHOICE
                    bool "I2C2 mode"
                    default I2C2_MODE_MASTER
                    config I2C2_MODE_MASTER
                        bool "Master"
                    config I2C2_MODE_SLAVE
                        bool "Slave"
                endchoice
                config I2C2_MODE
                    int
                    default 0 if I2C2_MODE_MASTER
                    default 1 if I2C2_MODE_SLAVE
            endif

            config RT_USING_I2C3
                bool "Enable I2C3"
                default n
            if RT_USING_I2C3
                choice I2C3_MODE_CHOICE
                    bool "I2C3 mode"
                    default I2C3_MODE_MASTER
                    config I2C3_MODE_MASTER
                        bool "Master"
                    config I2C3_MODE_SLAVE
                        bool "Slave"
                endchoice
                config I2C3_MODE
                    int
                    default 0 if I2C3_MODE_MASTER
                    default 1 if I2C3_MODE_SLAVE
            endif

            config RT_USING_I2C4
                bool "Enable I2C4"
                default n
            if RT_USING_I2C4
                choice I2C4_MODE_CHOICE
                    bool "I2C4 mode"
                    default I2C4_MODE_MASTER
                    config I2C4_MODE_MASTER
                        bool "Master"
                    config I2C4_MODE_SLAVE
                        bool "Slave"
                endchoice
                config I2C4_MODE
                    int
                    default 0 if I2C4_MODE_MASTER
                    default 1 if I2C4_MODE_SLAVE
            endif
        endif

    menuconfig RT_USING_PDMA
        bool "Enable PDMA Driver"
        default n

        if RT_USING_PDMA
            config RT_PDMA_ENABLE_BUILTIN_TESTS
                bool "Enable PDMA test commands"
                depends on RT_USING_MSH
                default n
                help
                    Enable the pdma_selftest and pdma_uart3_loopback MSH
                    commands. These tests use UART2/UART3 and allocate PDMA
                    channels while they run.
        endif

    menuconfig RT_USING_PWM
        bool "Using PWM device drivers"
        default n

        if RT_USING_PWM
            config RT_PWM_ENABLE_BUILTIN_CMD
                bool "Enable pwm test command"
                depends on RT_USING_MSH
                default n
        endif

    menuconfig RT_USING_RTC_PMU
        bool "Using RTC/PMU device drivers"
        default n
        select RT_USING_RTC

    if RT_USING_RTC_PMU
        menu "PMU PAD64 long press"
            config RT_PMU_LONG_PRESS_SHUTDOWN_CONFIG
                bool "Modify PMU long press shutdown seconds"
                default n
                help
                    Enable this option to override the software long-press
                    shutdown delay while the system is running.

            if RT_PMU_LONG_PRESS_SHUTDOWN_CONFIG
                config RT_PMU_SOFT_SHUTDOWN_SECONDS
                    int "PMU long press shutdown seconds"
                    default 5
                    range 1 30
            endif

            config RT_PMU_LONG_PRESS_POWERON_CONFIG
                bool "Modify PMU long press poweron seconds"
                default n
                help
                    Enable this option to override the PMU hardware
                    long-press wakeup threshold after poweroff.

            if RT_PMU_LONG_PRESS_POWERON_CONFIG
                config RT_PMU_LONG_PRESS_POWERON_SECONDS
                    int "PMU long press poweron seconds"
                    default 5
                    range 1 30
            endif
        endmenu

        menuconfig RT_PMU_SHUTDOWN_WAKEUP
            bool "PMU shutdown wakeup PADs"
            default n
            help
                Enable an extra PMU input PAD as a wakeup source after
                shutdown. PAD64 is reserved for the power-key long-press path.

        if RT_PMU_SHUTDOWN_WAKEUP
            menuconfig RT_PMU_SHUTDOWN_WAKEUP_PAD64
                bool "Enable PAD64 (power key) as edge/level shutdown wakeup"
                help
                    Reuse PAD64 as a generic edge/level shutdown wakeup
                    source, exactly like PAD65-PAD68: readable as GPIO at
                    runtime and armed for PMU wakeup at shutdown.

                    Enabling this GIVES UP the runtime power-key long-press
                    power-on/off behaviour on PAD64. Leave it disabled to
                    keep the long-press function.
            if RT_PMU_SHUTDOWN_WAKEUP_PAD64
                source "drivers/interdrv/pmu/Kconfig.pad64"
            endif

            menuconfig RT_PMU_SHUTDOWN_WAKEUP_PAD65
                bool "Enable PAD65 shutdown wakeup"
            if RT_PMU_SHUTDOWN_WAKEUP_PAD65
                source "drivers/interdrv/pmu/Kconfig.pad65"
            endif

            menuconfig RT_PMU_SHUTDOWN_WAKEUP_PAD66
                bool "Enable PAD66 shutdown wakeup"
            if RT_PMU_SHUTDOWN_WAKEUP_PAD66
                source "drivers/interdrv/pmu/Kconfig.pad66"
            endif

            menuconfig RT_PMU_SHUTDOWN_WAKEUP_PAD67
                bool "Enable PAD67 shutdown wakeup"
            if RT_PMU_SHUTDOWN_WAKEUP_PAD67
                source "drivers/interdrv/pmu/Kconfig.pad67"
            endif

            menuconfig RT_PMU_SHUTDOWN_WAKEUP_PAD68
                bool "Enable PAD68 shutdown wakeup"
                default y
            if RT_PMU_SHUTDOWN_WAKEUP_PAD68
                source "drivers/interdrv/pmu/Kconfig.pad68"
            endif

            menuconfig RT_PMU_SHUTDOWN_WAKEUP_PAD69
                bool "Enable PAD69 shutdown wakeup"
            if RT_PMU_SHUTDOWN_WAKEUP_PAD69
                source "drivers/interdrv/pmu/Kconfig.pad69"
            endif
        endif
    endif

    menuconfig RT_USING_SDIO
        bool "Enable SDIO Driver"
        default n

        if RT_USING_SDIO
            config RT_USING_SDIO0
                bool "Enable SDIO0"
                default n

            if RT_USING_SDIO0
                config RT_SDIO0_EMMC
                    bool "SDIO0 device is emmc"
                    default n

                config RT_SDIO0_1V8
                    bool "SDIO0 device is 1.8V"
                    default n

                config RT_SDIO0_HS200
                    bool "Enable SDIO0 eMMC HS200"
                    depends on RT_SDIO0_EMMC && RT_SDIO0_1V8
                    default n
                    help
                        Advertise HS200 support for validated 1.8V eMMC boards.
                        Enable explicitly in board configurations after validation.

                choice
                    bool "SDIO0 Bus Max Width"
                    default SDIO0_BUS_WIDTH_4BIT

                    config SDIO0_BUS_WIDTH_4BIT
                        bool "4Bit"
                    config SDIO0_BUS_WIDTH_8BIT
                        bool "8Bit"
                endchoice

                config SDIO0_BUS_WIDTH
                    int
                    default 1 if SDIO0_BUS_WIDTH_4BIT
                    default 2 if SDIO0_BUS_WIDTH_8BIT

                config RT_SDIO0_UHS
                    bool "Enable SDIO0 SD UHS-I (1.8V signaling)"
                    depends on !RT_SDIO0_EMMC && !RT_SDIO0_1V8 && RT_USING_REGULATOR
                    default n
                    help
                        Needs hardware that switches the I/O bank supply between
                        3.3 V and 1.8 V, described as a board regulator. Modes
                        follow the controller: SDR104 needs the 200 MHz clock and
                        the tuning PHY. A card power switch is strongly advised:
                        a card left at 1.8 V survives a warm reset.

                config RT_SDIO0_VQMMC
                    string "SDIO0 I/O supply regulator"
                    depends on RT_SDIO0_UHS
                    default "sd0_vqmmc"

                config RT_SDIO0_VMMC
                    string "SDIO0 card power regulator (empty: none)"
                    depends on RT_SDIO0_UHS
                    default ""
            endif

            config RT_USING_SDIO1
                bool "Enable SDIO1"
                default n

            config RT_SDIO1_UHS
                bool "Enable SDIO1 SD UHS-I (1.8V signaling)"
                depends on RT_USING_SDIO1 && RT_USING_REGULATOR
                default n
                help
                    Needs hardware that switches the I/O bank supply between
                    3.3 V and 1.8 V, described as a board regulator. SDIO1 has
                    a 100 MHz clock and no tuning PHY: at most DDR50, or SDR50
                    where the controller does not require tuning for it. A card
                    power switch is strongly advised: a card left at 1.8 V
                    survives a warm reset.

            config RT_SDIO1_VQMMC
                string "SDIO1 I/O supply regulator"
                depends on RT_SDIO1_UHS
                default "sd1_vqmmc"

            config RT_SDIO1_VMMC
                string "SDIO1 card power regulator (empty: none)"
                depends on RT_SDIO1_UHS
                default ""

            config RT_SDIO_SKIP_INITIAL_PROBE
                bool "Skip SDIO probing on the first boot-storage scan"
                depends on RT_USING_SDIO0 || RT_USING_SDIO1
                default y
                help
                    The boot SD/MMC controller on supported boards is used for storage.
                    Skip SDIO CMD52 reset, its settle delay and CMD5 probing on its
                    first scan. Later scans use normal probing, even if the first fails.
                    SD/MMC power-up, identification and retry timings are unchanged.
                    Other hosts, including SDIO Wi-Fi, retain normal enumeration.
                    This setting is independent of fast boot. Disable it when using
                    an SDIO combo card on the boot host.

            config BSP_SDIO_CARD_MAX_SEG_SIZE_KB
                int "SD/SDIO maximum segment size (KiB)"
                depends on RT_USING_SDIO1 || (RT_USING_SDIO0 && !RT_SDIO0_EMMC)
                default 256
                range 1 2048
                help
                    Maximum amount of data submitted in one SD/SDIO request.
                    The SDHCI driver allocates an equally sized persistent SDMA
                    bounce buffer for every non-eMMC host.

            config BSP_SDIO_EMMC_MAX_SEG_SIZE_KB
                int "eMMC maximum segment size (KiB)"
                depends on RT_USING_SDIO0 && RT_SDIO0_EMMC
                default 1024
                range 1 2048
                help
                    Maximum amount of data submitted in one eMMC request. The
                    SDHCI driver allocates an equally sized persistent SDMA
                    bounce buffer for the eMMC host.

            config BSP_SDIO_STORAGE_WRITE_TIMEOUT_MS
                int "SD/MMC storage write request watchdog (ms)"
                default 5000
                range 1000 120000
                help
                    Software watchdog applied to a complete write request for
                    SD, MMC/eMMC, and SDIO combo storage. Slow managed-flash
                    storage can occasionally spend seconds doing internal
                    garbage collection during metadata-heavy workloads. This
                    watchdog is independent of the controller instance and is
                    separate from the controller data timeout.

            config BSP_SDIO_IO_WRITE_TIMEOUT_MS
                int "SDIO device write request watchdog (ms)"
                default 1000
                range 1000 120000
                help
                    Software watchdog applied to a complete SDIO CMD53 write
                    request, including I/O functions on SDIO combo cards. This
                    setting is independent of the controller instance.

            config RT_SDIO_ENABLE_REPROBE_CMD
                bool "Enable secondary-card reprobe command"
                depends on RT_USING_MSH && MOUNT_SECOND_CARD
                default n
                help
                    Enable the sdio_reprobe MSH command. The command removes,
                    resets, reprobes, and remounts the secondary SD card.
        endif

    menuconfig RT_USING_SPI
        bool "Enable SPI Driver"
        default n
        select RT_USING_FPIOA

        if RT_USING_SPI
            config RT_USING_SPI0
                bool "Enable SPI0"
                default n
            config RT_SPI0_RXSD
                int "SPI0 ReadSample Delay"
                default 0

            config RT_USING_SPI1
                bool "Enable SPI1"
                default n
            config RT_SPI1_RXSD
                int "SPI1 ReadSample Delay"
                default 0

            config RT_USING_SPI2
                bool "Enable SPI2"
                default n
            config RT_SPI2_RXSD
                int "SPI2 ReadSample Delay"
                default 0

            config RT_SPI1_ENABLE_LOOPBACK_TEST
                bool "Enable SPI1 loopback test command"
                depends on RT_USING_SPI1 && RT_USING_MSH
                default n
                help
                    Enable the spi1_loopback MSH command. The test temporarily
                    reconfigures GPIO14-GPIO17 and requires GPIO16 and GPIO17
                    to be connected.
        endif


    config K230_PM_RUNTIME
        bool
        default y
        help
            Enable the K230 PM resource-table layer and read-only msh dump
            commands used to audit clocks, power domains, resets and device
            bindings before runtime get/put migration.

        if K230_PM_RUNTIME
            config K230_PM_DEBUG
                bool "Enable K230 PM debug traces"
                default n
                depends on RT_USING_MSH

            config K230_PM_CMD
                bool "Enable K230 PM msh commands"
                default y
                depends on RT_USING_MSH
                help
                    Build k230_pm command helpers such as k230_clk_dump,
                    k230_pd_dump, k230_pm_dump, k230_pm_release_boot,
                    k230_pm_dvfs_dump and k230_pm_selftest.

            config K230_PM_AGGRESSIVE_DEFAULT
                bool "Release runtime-manageable boot pins late in boot"
                default y
                help
                    Drop boot-seeded references for clocks and power domains marked
                    runtime-manageable after drivers have registered their gets.

            config K230_PM_DVFS
                bool "Enable K230 DVFS policy layer and /dev/pm"
                default y
                depends on RT_USING_PM
                select RT_USING_USAGE
                help
                    Provide the PM policy layer, DVFS profiles, governors, thermal
                    protection and the userspace-compatible /dev/pm device from the
                    k230_pm driver.

            menuconfig K230_PM_THERMAL_PROTECT
                bool "Enable K230 PM thermal protection"
                default y
                depends on K230_PM_DVFS
                select RT_USING_TS
                help
                    Monitor-owned temperature sampling, fixed protection
                    stages with verified clock ceilings, optional step-wise
                    regulation below them, and latched critical and
                    sustained-heat responses. Boot does not wait for the
                    sensor: default profiles apply at once and the first
                    reading lowers them if needed. A sensor that stops reporting
                    forces minimum clocks. Thresholds and time budgets
                    require board validation.

            if K230_PM_THERMAL_PROTECT
                comment "Protection and shutdown"

                config K230_PM_THERMAL_CRITICAL_C
                    int "Critical shutdown temperature (C)"
                    range 50 115
                    default 105
                    help
                        A reading at this temperature, confirmed by an
                        immediate second successful reading within the sensor
                        noise band, requests the selected shutdown backend. A
                        failed confirmation keeps minimum protection pending
                        and is retried; it does not by itself request shutdown.
                        With the NONE backend, a confirmed event instead stays
                        at minimum clocks while CPU, KPU and VPU work remains
                        available. The
                        stage step is the
                        smaller of 5 C and (critical - target) / 4, retaining
                        fractional degrees: WARM -3 steps, HOT -2, MIN -1.
                        Hysteresis follows the step. Sustained
                        shutdown follows 30 s at MIN heat once every throttled
                        domain is verified at its minimum clock. The default
                        105 C with target 85 C gives stages of 90/95/100 C.

                        Stage ceilings come from each domain's DVFS table:
                        WARM one profile below maximum, HOT two below, MIN the
                        minimum. CPU 1188/800/200 MHz, KPU 400/266/100 MHz,
                        VPU 600/400/200 MHz.

                        The datasheet specifies the sensor to 125 C with
                        +/-3 C untrimmed accuracy but no maximum die
                        temperature: validate the board before raising this.
                        For board testing, lower this value and the regulation
                        target directly. The same protection stages apply.

                choice
                    prompt "Thermal shutdown backend"
                    default K230_PM_THERMAL_SHUTDOWN_NONE
                    help
                        The default NONE backend keeps the system and all
                        domains available at minimum clocks after a shutdown
                        condition. This is a development-safe default.
                        Production configurations that require terminal
                        thermal protection must explicitly select and validate
                        HALT or PMU. PMU rail removal must be verified on the
                        board; a CPU halt does not prove power-off.
                    config K230_PM_THERMAL_SHUTDOWN_NONE
                        bool "No system shutdown (hold minimum protection)"
                        help
                            Latch and report the first shutdown reason and
                            retain minimum clock caps, but do not block CPU,
                            KPU or VPU work, quiesce the system, disable
                            interrupts, halt, reset or request PMU rail
                            power-off. The latched reason and minimum caps
                            remain until a normal reboot.
                    config K230_PM_THERMAL_SHUTDOWN_PMU
                        bool "PMU rail power-off request with halt fallback"
                        depends on RT_USING_RTC_PMU
                        help
                            Needs the PMU 32 kHz domain (RTC crystal and
                            LP-LDO), as does RT_USING_RTC_PMU: on boards
                            without it any PMU register access stalls the CPU.
                    config K230_PM_THERMAL_SHUTDOWN_HALT
                        bool "Halt fallback (no verified PMU rail control)"
                endchoice

                config K230_PM_THERMAL_COOLDOWN_RESTART
                    bool "Restart after a thermal halt once the chip has cooled"
                    default y
                    depends on !K230_PM_THERMAL_SHUTDOWN_NONE
                    help
                        When the halt fallback is reached (HALT backend, or a
                        PMU request that did not remove power), keep reading
                        the sensor and reset the SoC after 60 s below the lower
                        of 70 C and the configured thermal target. With a low
                        test target the idle die may never get that cool, and
                        the board then stays halted.
                        Regulators keep the low voltages DVFS left them at
                        across the reset: SPL must restore the CPU rail before
                        the big core runs (U-Boot with the TPS6286x regulator
                        and the boot-on vdd_cpu rail). An older SPL boots the
                        big core at full clock on the low voltage.
                        Startup applies the default profiles without waiting;
                        the first fresh reading lowers them when required.
                        Not used after a sensor outage or a thermal
                        initialization failure. In a persistently hot
                        enclosure the board cycles slowly instead of staying
                        off.

                config K230_PM_THERMAL_SHUTDOWN_ON_SENSOR_FAULT
                    bool "Shut down on persistent temperature sensor outage"
                    default n
                    depends on !K230_PM_THERMAL_SHUTDOWN_NONE
                    help
                        Without this option, a sensor outage lasting ten
                        seconds beyond the next scheduled acquisition holds
                        minimum clocks, refuses new accelerator work and
                        powers off idle accelerator domains until fresh
                        measurements satisfy the recovery hold. Domains still
                        referenced by a client stay powered.

                comment "Regulation"

                config K230_PM_THERMAL_REGULATION
                    bool "Step-wise thermal regulation below the protection stages"
                    default y
                    help
                        Best-effort regulation toward a target below WARM,
                        modelled on Linux's step_wise governor. One ladder
                        interleaves the CPU, KPU and VPU DVFS profiles in the
                        order set by the cut weights. Every two seconds above
                        the target it lowers the next profile that reduces a
                        running clock; after 10 s below the target band it
                        raises one, so a cut that briefly cools the die is not
                        undone at once. Regulation starts one stage step below the
                        target, and missing samples hold its position. The
                        protection stages, critical and sustained shutdown
                        work independently and are the only verified
                        protection. Disable to keep the stages alone.

                config K230_PM_THERMAL_TARGET_C
                    int "Thermal target temperature (C)"
                    range 30 95
                    default 30 if K230_PM_THERMAL_CRITICAL_C < 55
                    default 35 if K230_PM_THERMAL_CRITICAL_C < 60
                    default 40 if K230_PM_THERMAL_CRITICAL_C < 65
                    default 45 if K230_PM_THERMAL_CRITICAL_C < 70
                    default 50 if K230_PM_THERMAL_CRITICAL_C < 75
                    default 55 if K230_PM_THERMAL_CRITICAL_C < 80
                    default 60 if K230_PM_THERMAL_CRITICAL_C < 85
                    default 65 if K230_PM_THERMAL_CRITICAL_C < 90
                    default 70 if K230_PM_THERMAL_CRITICAL_C < 95
                    default 75 if K230_PM_THERMAL_CRITICAL_C < 100
                    default 80 if K230_PM_THERMAL_CRITICAL_C < 105
                    default 85 if K230_PM_THERMAL_CRITICAL_C < 110
                    default 90 if K230_PM_THERMAL_CRITICAL_C < 115
                    default 95
                    help
                        Must be at least 8 C below critical, allowing four
                        bands of at least 2 C. Stage spacing is calculated as
                        (critical - target) / 4, capped at 5 C. For example,
                        critical 55 C and target 45 C give 2.5 C steps and
                        WARM/HOT/MIN at 47.5/50/52.5 C. The sensor noise band
                        is 1 C, reduced to 0.9 C for 2 C steps.

                        This also sets protection spacing and cooldown when
                        regulation is disabled. The
                        default follows the critical temperature but a saved
                        value does not, so lower both together for board
                        testing. The default is critical minus 20 C rounded
                        down to a multiple of 5 C.

                config K230_PM_THERMAL_WEIGHT_CPU
                    int "Cut weight: CPU"
                    depends on K230_PM_THERMAL_REGULATION
                    range 0 8
                    default 1
                    help
                        Cut order. Each domain's profile steps are spread over
                        the ladder by their fraction of its range divided by
                        its weight, so a heavier domain is lowered sooner.
                        Equal weights interleave the domains evenly. Weight 0
                        leaves a domain to the protection stages only; with
                        every weight 0 regulation has nothing to lower.

                        EVB measurements with an AI and video pipeline:
                        halving the KPU clock cost about 5% of inference rate;
                        one CPU step (1188 -> 800 MHz, with its voltage)
                        cooled the die about 2.5 C; halving the VPU clock saved
                        0.4 C under full load (1.3 C alone) for half the video
                        throughput. For such a pipeline KPU 4, CPU 2, VPU 0
                        is a good starting point.

                config K230_PM_THERMAL_WEIGHT_KPU
                    int "Cut weight: KPU"
                    depends on K230_PM_THERMAL_REGULATION
                    range 0 8
                    default 1
                    help
                        See the CPU weight. On the EVB the KPU clock barely
                        limited inference rate, which makes it the cheapest
                        cut.

                config K230_PM_THERMAL_WEIGHT_VPU
                    int "Cut weight: VPU"
                    depends on K230_PM_THERMAL_REGULATION
                    range 0 8
                    default 1
                    help
                        See the CPU weight. The VPU steps through
                        800/600/400/300/200 MHz at a fixed voltage, so each
                        cut saves little heat. Its clock also drives the VPU
                        bus and DDR port 2, which the DPU shares.

                comment "Diagnostics"

                choice
                    prompt "Thermal log level"
                    default K230_PM_THERMAL_LOG_EVENTS
                    help
                        Configuration errors, unconfirmed critical readings and
                        shutdowns are logged at every level.
                    config K230_PM_THERMAL_LOG_ERRORS
                        bool "Errors: sensor faults"
                        help
                            Log a sensor entering or leaving a fault, and every
                            10 s while it lasts.
                    config K230_PM_THERMAL_LOG_EVENTS
                        bool "Events: errors and protection stage changes"
                        help
                            Also log each change of protection stage, so
                            throttling starting and stopping is visible. A
                            normal boot logs nothing.
                    config K230_PM_THERMAL_LOG_VERBOSE
                        bool "Verbose: also configuration and sensor start"
                        help
                            Also print the thresholds, stage ceilings and cut
                            weights at startup, and every sensor state change,
                            including the sensor coming up at boot.
                endchoice

                config K230_PM_THERMAL_TRACE
                    bool "Log every thermal observation"
                    default n
                    help
                        Prints acquisition tick, temperature, sequence, stage,
                        ceiling, regulation level, and the caps and read-back
                        clocks of every domain for each new sample: up to
                        four lines per second while throttled. For heating
                        and cooling-rate measurements.

            endif

        endif

    menuconfig DRV_SYSCTL_BOOT_FORCE_MODE
        bool "Force Sysctl Boot Mode"
        default n

        if DRV_SYSCTL_BOOT_FORCE_MODE
            choice
                bool "Force Sysctl Boot From"
                default DRV_SYSCTL_BOOT_FORCE_MODE_MODE_SDCARD

                config DRV_SYSCTL_BOOT_FORCE_MODE_MODE_SPI_NOR
                    bool "Spi Nor Flash"
                config DRV_SYSCTL_BOOT_FORCE_MODE_MODE_SPI_NAND
                    bool "Spi Nand Flash"
                config DRV_SYSCTL_BOOT_FORCE_MODE_MODE_EMMC
                    bool "Emmc (SDIO0)"
                config DRV_SYSCTL_BOOT_FORCE_MODE_MODE_SDCARD
                    bool "SdCard (SDIO1)"
            endchoice

            config DRV_SYSCTL_BOOT_FORCE_MODE_MODE
                int
                default 0 if DRV_SYSCTL_BOOT_FORCE_MODE_MODE_SPI_NOR
                default 1 if DRV_SYSCTL_BOOT_FORCE_MODE_MODE_SPI_NAND
                default 2 if DRV_SYSCTL_BOOT_FORCE_MODE_MODE_EMMC
                default 3 if DRV_SYSCTL_BOOT_FORCE_MODE_MODE_SDCARD
        endif

    menuconfig RT_USING_TS
        bool "Enable Tsensor driver"
        default n

        if RT_USING_TS
            config DRV_TS_USE_RT_DEVICE
                bool "Tsensor driver use RT Device framework"
                default n
        endif

    menuconfig RT_USING_SERIAL
        bool "USING Serial device drivers"
        default n

        if RT_USING_SERIAL
            config RT_SERIAL_ENABLE_UART0
                bool "Enable Uart device 0"
                default y
            config RT_SERIAL_ENABLE_UART1
                bool "Enable Uart device 1"
                default y
            config RT_SERIAL_ENABLE_UART2
                bool "Enable Uart device 2"
                default y
            config RT_SERIAL_ENABLE_UART3
                bool "Enable Uart device 3"
                default y
            config RT_SERIAL_ENABLE_UART4
                bool "Enable Uart device 4"
                default y

            config RT_SERIAL_RECV_BUF_SIZE
                hex "Uart Device Recv Buffer Size"
                default 0x4000
        endif

    config RT_USING_WDT
        bool "Using Watch Dog device drivers"
        default n

    config RT_USING_GZIP_DECOMP
        bool "Using HW gzip decompress driver"
        default n

endmenu
```
