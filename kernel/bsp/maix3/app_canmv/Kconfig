## kernel/bsp/maix3/app_canmv/Kconfig
```kconfig
menu "Applications CanMV Configuration"

    config RT_RECOVERY_MPY_AUTO_EXEC_PY
        bool "Enable recovery micropython auto execute boot.py or main.py make system crash"
        default n

    menuconfig MOUNT_SECOND_CARD
        bool "Mount second mmc card"
        depends on RT_USING_SDIO0 && RT_USING_SDIO1
        depends on !BSP_USING_WIFI_SDIO
        default n
        help
            Mount both SD/MMC controllers as storage. This is mutually
            exclusive with assigning one of the controllers to SDIO Wi-Fi.

        if MOUNT_SECOND_CARD
            config SECOND_CARD_CD_GPIO
                int "Second card-detect GPIO (-1 disables hotplug detection)"
                range -1 63
                default -1
                help
                    Use this GPIO to detect insertion and removal of the second
                    SD/MMC card. The pin is configured as an input and monitored on
                    both edges. Set it to -1 if the slot has no card-detect signal.

            config SECOND_CARD_CD_ACTIVE_LOW
                bool "Second card-detect signal is active low"
                depends on SECOND_CARD_CD_GPIO >= 0
                default y
        endif

endmenu
```

## kernel/bsp/maix3/board/Kconfig
```kconfig
menu "Board Configuration"

    choice RT_BOARD_CHIP_TYPE
        bool "Board Chip"
        default RT_BOARD_CHIP_K230

        config RT_BOARD_CHIP_K230
            bool "K230"

        config RT_BOARD_CHIP_K230D
            bool "K230D"
    endchoice

    config RT_USING_MPP
        bool "Use Kendryte MPP"
        default y
        select RT_USING_HWTIMER
        select RT_USING_HW_TIMER5

    config RT_FASTBOOT
        bool "Fastboot, disable some log output"
        default n

    config BSP_USING_SPI_NAND
        bool "Register board SPI NAND filesystem partitions"
        depends on LPKG_USING_SPINAND
        default y
        help
            Attach and configure the board's SPI NAND and register its
            spinand_parts.h partitions. Disable to use the driver with
            your own board setup. Existing SPI NAND configurations keep
            their automatic board registration by default.

    if BSP_USING_SPI_NAND

    choice
        bool "SPI Nand On"

        config SPI_NAND_ON_OSPI
            bool "ospi"
        config SPI_NAND_ON_QSPI0
            bool "qspi0"
        config SPI_NAND_ON_QSPI1
            bool "qspi1"
    endchoice

    config SPI_NAND_SPI_DEV
        string
        default "spi0" if SPI_NAND_ON_OSPI
        default "spi1" if SPI_NAND_ON_QSPI0
        default "spi2" if SPI_NAND_ON_QSPI1

    choice
        bool "SPI Nand Bus Width"
        default SPI_NAND_SPI_BUS_WIDTH_4

        config SPI_NAND_SPI_BUS_WIDTH_1
            bool "1"
        config SPI_NAND_SPI_BUS_WIDTH_2
            bool "2"
        config SPI_NAND_SPI_BUS_WIDTH_4
            bool "4"
    endchoice

    config SPI_NAND_SPI_BUS_WIDTH
        int
        default 1 if SPI_NAND_SPI_BUS_WIDTH_1
        default 2 if SPI_NAND_SPI_BUS_WIDTH_2
        default 4 if SPI_NAND_SPI_BUS_WIDTH_4

    config SPI_NAND_SPI_FREQ
        int "SPI Nand Bus Freq"
        default 50000000

    endif

    config BSP_USING_SPI_NOR
        bool "Boot SPI NOR filesystem partitions on SPI0 CS0"
        depends on RT_USING_DFS && RT_USING_SPI && RT_USING_SPI0
        select RT_USING_DFS_JFFS2
        select RT_JFFS2_USING_ZLIB
        select RT_USING_MTD_NOR
        select RT_USING_SPINOR
        default n
        help
            Register the board's spinor_parts.h partitions as MTD NOR devices
            for compressed JFFS2 using the native SPI NOR driver, with
            64 KiB erase blocks.

    config BSP_SPI_NOR_MAX_HZ
        int "Boot SPI NOR maximum clock (Hz)"
        depends on BSP_USING_SPI_NOR
        range 1000000 100000000
        default 50000000
        help
            Board/flash wiring limit, equivalent to spi-max-frequency in
            U-Boot's device tree. Choose a rate supported by the fitted chip.
            Probe/fallback use at most 50 MHz; the controller rounds SCK down.

    config BSP_SPI_NOR_MAX_LINES
        int "Boot SPI NOR data lines wired"
        depends on BSP_USING_SPI_NOR
        range 1 8
        default 4
        help
            Data lines between SPI0 and the flash: 1, 2, 4 or 8. Reads use the
            widest mode both the chip profile and this wiring allow.

    config RT_BOARD_ENABLE_PINMUX
        bool "Enable Pinmux Configure"
        select RT_BOARD_ENABLE_PIN_INIT_SEQUENCE
        select RT_USING_FPIOA
        default n

    config RT_BOARD_ENABLE_PIN_INIT_SEQUENCE
        bool "Enable Board Specific Pin Init Sequence"
        select RT_USING_FPIOA
        default n
        help
            Build the board pin init hook without applying the full pinmux table.

endmenu
```

## kernel/bsp/maix3/drivers/extdrv/Kconfig
```kconfig
menu "External Drivers"

menu "Wi-Fi Drivers"
    source "drivers/extdrv/rw007/Kconfig"
    source "drivers/extdrv/cyw43xx/Kconfig"
    source "drivers/extdrv/brcmfmac/Kconfig"
    source "drivers/extdrv/realtek/Kconfig"
    source "drivers/extdrv/aic8800/Kconfig"
    source "drivers/extdrv/esp_hosted/Kconfig"
    source "drivers/extdrv/esp_hosted_mcu/Kconfig"

    config BSP_USING_WIFI_SDIO
        bool
        default y if RT_USING_CYW43XX
        default y if RT_USING_BRCMFMAC
        default y if RT_USING_REALTEK
        default y if RT_USING_RTL8189
        default y if AIC8800_WIFI_TRANSPORT_SDIO
        default y if ESP_HOSTED_WIFI_TRANSPORT_SDIO

    if BSP_USING_WIFI_SDIO

        menu "SDIO Wi-Fi Board Bus"

            choice
                prompt "Host controller"
                default BSP_WIFI_SDIO_HOST_1
                help
                    Select the controller wired to the board's Wi-Fi module.
                    Many SD-card-boot boards use SDIO0 for Wi-Fi, while
                    01Studio uses SDIO1. Confirm with the board schematic.
                    This selection enables the required SDIO controller;
                    disabling a controller must not move Wi-Fi to another bus.
                    The boot disk and Wi-Fi must use different controllers.
                    Disable all SDIO Wi-Fi drivers/transports before disabling
                    their controller to save power. USB Wi-Fi can stay enabled.

                config BSP_WIFI_SDIO_HOST_0
                    bool "SDIO0"
                    select RT_USING_SDIO0

                config BSP_WIFI_SDIO_HOST_1
                    bool "SDIO1"
                    select RT_USING_SDIO1
            endchoice

            config BSP_WIFI_SDIO_HOST
                int
                default 0 if BSP_WIFI_SDIO_HOST_0
                default 1 if BSP_WIFI_SDIO_HOST_1

            config BSP_WIFI_SDIO_REG_ON_PIN
                int "REG_ON/reset GPIO (-1 uses board wiring)"
                range -1 63
                default -1
                help
                    GPIO shared by the SDIO Wi-Fi socket. The board resets
                    this signal once before probing all enabled vendor
                    drivers. Use -1 when the signal is not GPIO-controlled.

            config BSP_WIFI_SDIO_RESET_ACTIVE_LOW
                bool "REG_ON/reset is asserted low"
                default y

            config BSP_WIFI_SDIO_RESET_PULSE_MS
                int "Reset assertion time (ms)"
                range 1 1000
                default 200

            config BSP_WIFI_SDIO_POWER_UP_DELAY_MS
                int "Power-up delay before card detection (ms)"
                range 1 1000
                default 50

            config BSP_WIFI_SDIO_USE_SDIO0_RESET
                bool "Use the SDIO0 hardware reset output"
                depends on BSP_WIFI_SDIO_HOST_0 && BSP_WIFI_SDIO_REG_ON_PIN < 0
                default y
                help
                    Toggle the SDIO0 reset output when the module reset is
                    wired to the controller rather than a GPIO.

        endmenu

    endif
endmenu

    source "drivers/extdrv/spinand/Kconfig"
    source "drivers/extdrv/spinor/Kconfig"
    source "drivers/extdrv/lsm6dsm/Kconfig"
    source "drivers/extdrv/touch/Kconfig"
    source "drivers/extdrv/regulator/Kconfig"
    source "drivers/extdrv/ws2812/Kconfig"
    source "drivers/extdrv/onewire/Kconfig"

endmenu
```
